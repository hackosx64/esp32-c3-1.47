static const uint16_t _sine_table[128] = {
    4096, 4296, 4497, 4696, 4894, 5090, 5284, 5475, 5662, 5846, 6026, 6200, 6370, 6535, 6693, 6845, 
    6991, 7129, 7261, 7384, 7500, 7607, 7707, 7797, 7878, 7951, 8014, 8067, 8111, 8146, 8170, 8185, 
    8190, 8185, 8170, 8146, 8111, 8067, 8014, 7951, 7878, 7797, 7707, 7607, 7500, 7384, 7261, 7129, 
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    1200, 1346, 1498, 1656, 1821, 1991, 2165, 2345, 2529, 2716, 2907, 3101, 3297, 3495, 3694, 3895
};

static const uint16_t _triangle_table[128] = {
    0, 128, 256, 384, 512, 640, 768, 896, 1024, 1152, 1280, 1408, 1536, 1664, 1792, 1920, 
    2048, 2176, 2304, 2432, 2560, 2688, 2816, 2944, 3072, 3200, 3328, 3456, 3584, 3712, 3840, 3968, 
    4096, 4223, 4351, 4479, 4607, 4735, 4863, 4991, 5119, 5247, 5375, 5503, 5631, 5759, 5887, 6015, 
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    2048, 1920, 1792, 1664, 1536, 1408, 1280, 1152, 1024, 896, 768, 640, 512, 384, 256, 128
};

static const uint16_t _saw_table[128] = {
    0, 64, 129, 193, 258, 322, 387, 451, 516, 580, 645, 709, 774, 838, 903, 967, 
    1032, 1096, 1161, 1225, 1290, 1354, 1419, 1483, 1548, 1612, 1677, 1741, 1806, 1870, 1935, 1999, 
    2064, 2128, 2193, 2257, 2322, 2386, 2451, 2515, 2580, 2644, 2709, 2773, 2838, 2902, 2967, 3031, 
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    7224, 7288, 7353, 7417, 7482, 7546, 7611, 7675, 7740, 7804, 7869, 7933, 7998, 8062, 8127, 8191
};

static const uint16_t _square_table[128] = {
    8191, 8191, 8191, 8191, 8191, 8191, 8191, 8191, 8191, 8191, 8191, 8191, 8191, 8191, 8191, 8191, 
    8191, 8191, 8191, 8191, 8191, 8191, 8191, 8191, 8191, 8191, 8191, 8191, 8191, 8191, 8191, 8191, 
    8191, 8191, 8191, 8191, 8191, 8191, 8191, 8191, 8191, 8191, 8191, 8191, 8191, 8191, 8191, 8191, 
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    0, 0, 0, 0, 0, 0, 0, 0, 0, 0, 0, 0, 0, 0, 0, 0
};

static const uint16_t _pwm_table[128] = {
    8191, 8191, 8191, 8191, 8191, 8191, 8191, 8191, 8191, 8191, 8191, 8191, 8191, 8191, 8191, 8191, 
    8191, 8191, 8191, 8191, 8191, 8191, 8191, 8191, 8191, 8191, 8191, 8191, 8191, 8191, 8191, 8191, 
    0, 0, 0, 0, 0, 0, 0, 0, 0, 0, 0, 0, 0, 0, 0, 0, 
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    0, 0, 0, 0, 0, 0, 0, 0, 0, 0, 0, 0, 0, 0, 0, 0
};

static const uint16_t _burst_table[128] = {
    8191, 8191, 0, 0, 0, 0, 0, 0, 8191, 8191, 0, 0, 0, 0, 0, 0, 
    8191, 8191, 0, 0, 0, 0, 0, 0, 8191, 8191, 0, 0, 0, 0, 0, 0, 
    8191, 8191, 0, 0, 0, 0, 0, 0, 8191, 8191, 0, 0, 0, 0, 0, 0, 
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    8191, 8191, 0, 0, 0, 0, 0, 0, 8191, 8191, 0, 0, 0, 0, 0, 0
};

static const uint16_t _stairs_table[128] = {
    0, 0, 0, 0, 0, 0, 0, 0, 0, 0, 0, 0, 0, 0, 0, 0, 
    1170, 1170, 1170, 1170, 1170, 1170, 1170, 1170, 1170, 1170, 1170, 1170, 1170, 1170, 1170, 1170, 
    2340, 2340, 2340, 2340, 2340, 2340, 2340, 2340, 2340, 2340, 2340, 2340, 2340, 2340, 2340, 2340, 
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    8191, 8191, 8191, 8191, 8191, 8191, 8191, 8191, 8191, 8191, 8191, 8191, 8191, 8191, 8191, 8191
};

